## Documentation/devicetree/bindings/power/supply/acer,aspire1-ec.yaml
```yaml
# SPDX-License-Identifier: (GPL-2.0-only OR BSD-2-Clause)
%YAML 1.2
---
$id: http://devicetree.org/schemas/power/supply/acer,aspire1-ec.yaml#
$schema: http://devicetree.org/meta-schemas/core.yaml#

title: Acer Aspire 1 Embedded Controller.

maintainers:
  - Nikita Travkin <nikita@trvn.ru>

description:
  The Acer Aspire 1 laptop uses an embedded controller to control battery
  and charging as well as to provide a set of misc features such as the
  laptop lid status and HPD events for the USB Type-C DP alt mode.

properties:
  compatible:
    const: acer,aspire1-ec

  reg:
    const: 0x76

  '#address-cells':
    const: 1

  '#size-cells':
    const: 0

  interrupts:
    maxItems: 1

  acer,media-keys-on-top:
    description: Configure the keyboard layout to use media features of
      the fn row when the fn key is not pressed. The firmware may choose
      to add this property when user selects the fn mode in the firmware
      setup utility.
    type: boolean

  connector:
    $ref: /schemas/connector/usb-connector.yaml#

    properties:
      reg:
        maxItems: 1

    unevaluatedProperties: false

required:
  - compatible
  - reg
  - interrupts

additionalProperties: false

examples:
  - |+
    #include <dt-bindings/interrupt-controller/irq.h>
    i2c {
        embedded-controller@76 {
            compatible = "acer,aspire1-ec";
            reg = <0x76>;

            interrupts-extended = <&tlmm 30 IRQ_TYPE_LEVEL_LOW>;

            #address-cells = <1>;
            #size-cells = <0>;

            connector {
                compatible = "usb-c-connector";

                port {
                    ec_dp_in: endpoint {
                        remote-endpoint = <&mdss_dp_out>;
                    };
                };
            };
        };
    };
```
